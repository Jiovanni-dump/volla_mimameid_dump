/dts-v1/;

/ {

	fragment@0 {
		target = <0xffffffff>;

		__overlay__ {

			reserve-memory-scp_share {
				compatible = "mediatek,reserve-memory-scp_share";
				no-map;
				size = <0x00 0xd00000>;
				alignment = <0x00 0x1000000>;
				alloc-ranges = <0x00 0x40000000 0x00 0x50000000>;
			};
		};
	};

	fragment@1 {
		target = <0xffffffff>;

		__overlay__ {
			atag,videolfb-fb_base_l = "~`P";
			atag,videolfb-fb_base_h = <0x00>;
			atag,videolfb-islcmfound = <0x01>;
			atag,videolfb-islcm_inited = <0x00>;
			atag,videolfb-fps = <0x1770>;
			atag,videolfb-vramSize = <0x17e8000>;
			atag,videolfb-lcmname = "hx83112b_fhdp_dsi_cmd_auo_rt5081_drv";
		};
	};

	fragment@2 {
		target = <0xffffffff>;

		__overlay__ {

			aw881xx_smartpa@34 {
				compatible = "mediatek,aw881xx_smartpa";
				reg = <0x34>;
				reset-gpio = <0xffffffff 0x1e 0x00>;
				irq-gpio = <0xffffffff 0x27 0x00>;
				status = "okay";
				phandle = <0x4c>;
			};
		};
	};

	fragment@3 {
		target = <0xffffffff>;

		__overlay__ {
			#address-cells = <0x01>;
			#size-cells = <0x00>;

			fingerprint@spi2 {
				compatible = "focaltech,fingerprint-spidev";
				reg = <0x00>;
				spi-max-frequency = <0xf4240>;
				status = "okay";
				phandle = <0x4d>;
			};
		};
	};

	fragment@4 {
		target = <0xffffffff>;

		__overlay__ {
			interrupt-parent = <0xffffffff>;
			interrupts = <0x05 0x02 0x05 0x00>;
			pinctrl-names = "default\0fpc_eint_as_int\0fpc_pins_rst_high\0fpc_pins_rst_low\0fpc_pins_pwr_high\0fpc_pins_pwr_low\0fpc_mode_as_cs\0fpc_mode_as_ck\0fpc_mode_as_mi\0fpc_mode_as_mo\0fpc_miso_pull_up\0fpc_miso_pull_down\0fpc_mosi_pull_up\0fpc_mosi_pull_down";
			pinctrl-0 = <0x01>;
			pinctrl-1 = <0x02>;
			pinctrl-2 = <0x03>;
			pinctrl-3 = <0x04>;
			pinctrl-4 = <0x05>;
			pinctrl-5 = <0x06>;
			pinctrl-6 = <0x07>;
			pinctrl-7 = <0x08>;
			pinctrl-8 = <0x09>;
			pinctrl-9 = <0x0a>;
			pinctrl-10 = <0x0b>;
			pinctrl-11 = <0x0c>;
			pinctrl-12 = <0x0d>;
			pinctrl-13 = <0x0e>;
			status = "okay";
		};
	};

	fragment@5 {
		target = <0xffffffff>;

		__overlay__ {

			fpcdefault {
				phandle = <0x01>;
			};

			fpceint@0 {
				phandle = <0x02>;

				pins_cmd_dat {
					pinmux = <0x500>;
					slew-rate = <0x00>;
					bias-disable;
				};
			};

			fpcrsthigh {
				phandle = <0x03>;

				pins_cmd_dat {
					pinmux = <0xb200>;
					slew-rate = <0x01>;
					output-high;
				};
			};

			fpcrstlow {
				phandle = <0x04>;

				pins_cmd_dat {
					pinmux = <0xb200>;
					slew-rate = <0x01>;
					output-low;
				};
			};

			fpcpwrhigh {
				phandle = <0x05>;

				pins_cmd_dat {
					pinmux = <0x400>;
					slew-rate = <0x01>;
					output-high;
				};
			};

			fpcpwrlow {
				phandle = <0x06>;

				pins_cmd_dat {
					pinmux = <0x400>;
					slew-rate = <0x01>;
					output-low;
				};
			};

			fpccs {
				phandle = <0x07>;

				pins_cmd_dat {
					pinmux = <0x1902>;
					bias-pull-up = <0x00>;
				};
			};

			fpcck {
				phandle = <0x08>;

				pins_cmd_dat {
					pinmux = <0x1b02>;
					bias-pull-up = <0x00>;
				};
			};

			fpcmi {
				phandle = <0x09>;

				pins_cmd_dat {
					pinmux = <0x1c02>;
					bias-pull-up = <0x00>;
				};
			};

			fpcmo {
				phandle = <0x0a>;

				pins_cmd_dat {
					pinmux = <0x1a02>;
					bias-pull-down = <0x00>;
				};
			};

			fpcmisoup {
				phandle = <0x0b>;

				pins_cmd_dat {
					pinmux = <0x1c00>;
					slew-rate = <0x01>;
					output-high;
				};
			};

			fpcmisolow {
				phandle = <0x0c>;

				pins_cmd_dat {
					pinmux = <0x1c00>;
					slew-rate = <0x01>;
					output-low;
				};
			};

			fpcmosiup {
				phandle = <0x0d>;

				pins_cmd_dat {
					pinmux = <0x1a00>;
					slew-rate = <0x01>;
					output-high;
				};
			};

			fpcmosilow {
				phandle = <0x0e>;

				pins_cmd_dat {
					pinmux = <0x1a00>;
					slew-rate = <0x01>;
					output-low;
				};
			};
		};
	};

	fragment@6 {
		target = <0xffffffff>;

		__overlay__ {

			led@0 {
				compatible = "mediatek,red";
				led_mode = <0x00>;
				data = <0x01>;
				pwm_config = <0x00 0x00 0x00 0x00 0x00>;
				phandle = <0x4e>;
			};

			led@1 {
				compatible = "mediatek,green";
				led_mode = <0x00>;
				data = <0x01>;
				pwm_config = <0x00 0x00 0x00 0x00 0x00>;
				phandle = <0x4f>;
			};

			led@2 {
				compatible = "mediatek,blue";
				led_mode = <0x00>;
				data = <0x01>;
				pwm_config = <0x00 0x00 0x00 0x00 0x00>;
				phandle = <0x50>;
			};

			led@3 {
				compatible = "mediatek,jogball-backlight";
				led_mode = <0x00>;
				data = <0x01>;
				pwm_config = <0x00 0x00 0x00 0x00 0x00>;
				phandle = <0x51>;
			};

			led@4 {
				compatible = "mediatek,keyboard-backlight";
				led_mode = <0x00>;
				data = <0x01>;
				pwm_config = <0x00 0x00 0x00 0x00 0x00>;
				phandle = <0x52>;
			};

			led@5 {
				compatible = "mediatek,button-backlight";
				led_mode = <0x00>;
				data = <0x01>;
				pwm_config = <0x00 0x00 0x00 0x00 0x00>;
				phandle = <0x53>;
			};

			led@6 {
				compatible = "mediatek,lcd-backlight";
				led_mode = <0x05>;
				data = <0x01>;
				pwm_config = <0x00 0x03 0x00 0x00 0x00>;
				phandle = <0x54>;
			};

			vibrator@0 {
				compatible = "mediatek,vibrator";
				vib_timer = <0x19>;
				vib_limit = <0x09>;
				vib_vol = <0x0b>;
				phandle = <0x55>;
			};
		};
	};

	fragment@7 {
		target = <0xffffffff>;

		__overlay__ {
			gpio_lcd_ldo18_pin = <0x4e>;
			gpio_lcd_bias_enp_pin = <0xa9>;
			gpio_lcd_bias_enn_pin = <0xa5>;
			gpio_lcd_ldo18_gpio = <0xffffffff 0x4e 0x00>;
			gpio_lcd_bias_enp_gpio = <0xffffffff 0xa9 0x00>;
			gpio_lcd_bias_enn_gpio = <0xffffffff 0xa5 0x00>;
		};
	};

	fragment@8 {
		target = <0xffffffff>;

		__overlay__ {
			clock-frequency = <0x61a80>;

			mtk-usb@60 {
				compatible = "mediatek,mtk-usb";
				reg = <0x60>;
				status = "okay";
			};
		};
	};

	fragment@9 {
		target = <0xffffffff>;

		__overlay__ {

			nfc {
				compatible = "mediatek,nfc-gpio-v2";
				gpio-rst = <0x9f>;
				gpio-rst-std = <0xffffffff 0x9f 0x00>;
				gpio-irq = <0x09>;
				gpio-irq-std = <0xffffffff 0x09 0x00>;
				phandle = <0x56>;
			};

			irq_nfc {
				compatible = "mediatek,irq_nfc-eint";
				interrupt-parent = <0xffffffff>;
				interrupts = <0x09 0x01 0x09 0x00>;
				debounce = <0x00>;
				status = "okay";
				phandle = <0x57>;
			};
		};
	};

	fragment@10 {
		target = <0xffffffff>;

		__overlay__ {

			nfc@08 {
				compatible = "mediatek,nfc";
				reg = <0x08>;
				status = "okay";
				phandle = <0x58>;
			};
		};
	};

	fragment@11 {
		target = <0xffffffff>;

		__overlay__ {
			accdet-mic-vol = <0x06>;
			headset-mode-setting = <0x500 0x500 0x01 0x1f0 0x800 0x800 0x20 0x44>;
			accdet-plugout-debounce = <0x01>;
			accdet-mic-mode = <0x01>;
			headset-eint-level-pol = <0x08>;
			headset-three-key-threshold = <0x00 0x50 0xdc 0x190>;
			headset-three-key-threshold-CDD = <0x00 0x79 0xc0 0x258>;
			headset-four-key-threshold = <0x00 0x3a 0x79 0xc0 0x190>;
			status = "okay";
		};
	};

	fragment@12 {
		target = <0xffffffff>;

		__overlay__ {
			pinctrl-names = "default";
			pinctrl-0 = <0x0f>;
		};
	};

	fragment@13 {
		target = <0xffffffff>;

		__overlay__ {

			kpdgpiodefault {
				phandle = <0x0f>;

				pins_cmd_dat {
					pinmux = <0x5d01>;
					bias-pull-up = <0x66>;
					input-enable;
					input-schmitt-enable;
				};
			};
		};
	};

	fragment@14 {
		target = <0xffffffff>;

		__overlay__ {

			consys_default {
				phandle = <0x10>;
			};

			gpslna@0 {
				phandle = <0x11>;

				pins_cmd_dat {
					pinmux = <0x9700>;
					slew-rate = <0x00>;
					bias-disable;
					output-low;
				};
			};

			gpslna@1 {
				phandle = <0x12>;

				pins_cmd_dat {
					pinmux = <0x9700>;
					slew-rate = <0x01>;
					output-high;
				};
			};

			gpslna@2 {
				phandle = <0x13>;

				pins_cmd_dat {
					pinmux = <0x9700>;
					slew-rate = <0x01>;
					output-low;
				};
			};

			fmlna@0 {
				phandle = <0x14>;

				pins_cmd_dat {
					pinmux = <0x1d00>;
					slew-rate = <0x00>;
					bias-disable;
					output-low;
				};
			};

			fmlna@1 {
				phandle = <0x15>;

				pins_cmd_dat {
					pinmux = <0x1d00>;
					slew-rate = <0x01>;
					output-high;
				};
			};

			fmlna@2 {
				phandle = <0x16>;

				pins_cmd_dat {
					pinmux = <0x1d00>;
					slew-rate = <0x01>;
					output-low;
				};
			};
		};
	};

	fragment@15 {
		target = <0xffffffff>;

		__overlay__ {
			pinctrl-names = "default\0gps_lna_state_init\0gps_lna_state_oh\0gps_lna_state_ol\0fm_lna_state_init\0fm_lna_state_oh\0fm_lna_state_ol";
			pinctrl-0 = <0x10>;
			pinctrl-1 = <0x11>;
			pinctrl-2 = <0x12>;
			pinctrl-3 = <0x13>;
			pinctrl-4 = <0x14>;
			pinctrl-5 = <0x15>;
			pinctrl-6 = <0x16>;
			status = "okay";
		};
	};

	fragment@16 {
		target = <0xffffffff>;

		__overlay__ {
			pinctrl-names = "irtx_gpio_led_default\0irtx_gpio_led_set";
			pinctrl-0 = <0x17>;
			pinctrl-1 = <0x18>;
			status = "okay";
		};
	};

	fragment@17 {
		target = <0xffffffff>;

		__overlay__ {

			irtx_gpio_led_def@gpio12 {
				phandle = <0x17>;

				pins_cmd_dat {
					pinmux = <0xc00>;
					slew-rate = <0x01>;
					bias-disable;
					output-low;
					input-schmitt-enable = <0x00>;
				};
			};

			irtx_gpio_led_set@gpio12 {
				phandle = <0x18>;

				pins_cmd_dat {
					pinmux = <0xc01>;
					slew-rate = <0x01>;
					output-high;
				};
			};
		};
	};

	fragment@18 {
		target = <0xffffffff>;

		__overlay__ {

			lcdbias_enp_high {
				phandle = <0x1a>;

				pins_cmd_dat {
					pinmux = <0xa900>;
					slew-rate = <0x01>;
					output-high;
				};
			};

			lcdbias_enp_low {
				phandle = <0x1b>;

				pins_cmd_dat {
					pinmux = <0xa900>;
					slew-rate = <0x01>;
					output-low;
				};
			};

			lcdbias_enn_high {
				phandle = <0x1c>;

				pins_cmd_dat {
					pinmux = <0xa500>;
					slew-rate = <0x01>;
					output-high;
				};
			};

			lcdbias_enn_low {
				phandle = <0x1d>;

				pins_cmd_dat {
					pinmux = <0xa500>;
					slew-rate = <0x01>;
					output-low;
				};
			};

			default {
				phandle = <0x19>;
			};
		};
	};

	fragment@19 {
		target = <0xffffffff>;

		__overlay__ {
			pinctrl-names = "default\0lcdbias_enp_high\0lcdbias_enp_low\0lcdbias_enn_high\0lcdbias_enn_low";
			pinctrl-0 = <0x19>;
			pinctrl-1 = <0x1a>;
			pinctrl-2 = <0x1b>;
			pinctrl-3 = <0x1c>;
			pinctrl-4 = <0x1d>;
		};
	};

	fragment@20 {
		target = <0xffffffff>;

		__overlay__ {

			aw2016@64 {
				compatible = "awinic,aw2016_led";
				reg = <0x64>;

				aw2016,red {
					aw2016,name = "red";
					aw2016,id = <0x00>;
					aw2016,imax = <0x05>;
					aw2016,led-current = <0x05>;
					aw2016,max-brightness = <0xff>;
					aw2016,rise-time-ms = <0x00>;
					aw2016,hold-time-ms = <0x04>;
					aw2016,fall-time-ms = <0x00>;
					aw2016,off-time-ms = <0x08>;
				};

				aw2016,green {
					aw2016,name = "green";
					aw2016,id = <0x01>;
					aw2016,imax = <0x00>;
					aw2016,led-current = <0x0a>;
					aw2016,max-brightness = <0xff>;
					aw2016,rise-time-ms = <0x01>;
					aw2016,hold-time-ms = <0x02>;
					aw2016,fall-time-ms = <0x01>;
					aw2016,off-time-ms = <0x08>;
				};
			};
		};
	};

	fragment@21 {
		target = <0xffffffff>;

		__overlay__ {

			lcm_rst_out1_gpio {
				phandle = <0x1e>;

				pins_cmd_dat {
					pinmux = <0x2d00>;
					slew-rate = <0x01>;
					output-high;
				};
			};

			lcm_rst_out0_gpio {
				phandle = <0x1f>;

				pins_cmd_dat {
					pinmux = <0x2d00>;
					slew-rate = <0x01>;
					output-low;
				};
			};

			lcm_dsi_te {
				phandle = <0x20>;

				pins_cmd_dat {
					pinmux = <0x2c01>;
				};
			};
		};
	};

	fragment@22 {
		target = <0xffffffff>;

		__overlay__ {
			pinctrl-names = "lcm_rst_out1_gpio\0lcm_rst_out0_gpio\0mode_te_te";
			pinctrl-0 = <0x1e>;
			pinctrl-1 = <0x1f>;
			pinctrl-2 = <0x20>;
			status = "okay";
		};
	};

	fragment@23 {
		target = <0xffffffff>;

		__overlay__ {

			aw36518_default {
				phandle = <0x21>;
			};

			aw36518_strobe_0 {
				phandle = <0x22>;

				pins_cmd_dat {
					pinmux = <0x9900>;
					slew-rate = <0x01>;
					output-low;
				};
			};

			aw36518_strobe_1 {
				phandle = <0x23>;

				pins_cmd_dat {
					pinmux = <0x9900>;
					slew-rate = <0x01>;
					output-high;
				};
			};

			aw36518_en_0 {
				phandle = <0x24>;

				pins_cmd_dat {
					pinmux = <0x9800>;
					slew-rate = <0x01>;
					output-low;
				};
			};

			aw36518_en_1 {
				phandle = <0x25>;

				pins_cmd_dat {
					pinmux = <0x9800>;
					slew-rate = <0x01>;
					output-high;
				};
			};
		};
	};

	fragment@24 {
		target = <0xffffffff>;

		__overlay__ {

			aw36518@63 {
				compatible = "mediatek,flashlights_aw36518";
				reg = <0x63>;
				status = "okay";
				pinctrl-names = "aw36518_default\0aw36518_strobe_0\0aw36518_strobe_1\0aw36518_en_0\0aw36518_en_1";
				pinctrl-0 = <0x21>;
				pinctrl-1 = <0x22>;
				pinctrl-2 = <0x23>;
				pinctrl-3 = <0x24>;
				pinctrl-4 = <0x25>;
			};
		};
	};

	fragment@25 {
		target = <0xffffffff>;

		__overlay__ {

			adc_channel@ {
				compatible = "mediatek,adc_channel";
				mediatek,temperature0 = <0x00>;
				mediatek,temperature1 = <0x01>;
				mediatek,adc_fdd_rf_params_dynamic_custom_ch = <0x02>;
				status = "okay";
			};
		};
	};

	fragment@26 {
		target = <0xffffffff>;

		__overlay__ {
			io-channels = <0xffffffff 0x02>;
		};
	};

	fragment@27 {
		target = <0xffffffff>;

		__overlay__ {
			mediatek,clkbuf-quantity = <0x07>;
			mediatek,clkbuf-config = <0x02 0x01 0x01 0x02 0x00 0x00 0x00>;
			mediatek,clkbuf-driving-current = <0x01 0x01 0x01 0x01 0x01 0x01 0x01>;
			status = "okay";
		};
	};

	fragment@28 {
		target = <0xffffffff>;

		__overlay__ {
			#address-cells = <0x01>;
			#size-cells = <0x00>;
			clock-frequency = <0x61a80>;
			mediatek,use-open-drain;

			cap_touch@14 {
				compatible = "mediatek,cap_touch";
				reg = <0x14>;
				status = "okay";
				phandle = <0x59>;
			};
		};
	};

	fragment@29 {
		target = <0xffffffff>;

		__overlay__ {
			#address-cells = <0x01>;
			#size-cells = <0x00>;
			clock-frequency = <0x61a80>;
			mediatek,use-open-drain;
		};
	};

	fragment@30 {
		target = <0xffffffff>;

		__overlay__ {
			#address-cells = <0x01>;
			#size-cells = <0x00>;
			clock-frequency = <0x61a80>;
			mediatek,use-open-drain;

			camera_main@1a {
				compatible = "mediatek,camera_main";
				reg = <0x1a>;
				status = "okay";
				phandle = <0x5a>;
			};

			camera_main_eeprom@50 {
				compatible = "mediatek,camera_main_eeprom";
				reg = <0x50>;
				status = "okay";
				phandle = <0x5b>;
			};

			camera_main_af@0c {
				compatible = "mediatek,camera_main_af";
				reg = <0x0c>;
				status = "okay";
				phandle = <0x5c>;
			};

			camera_main_two@10 {
				compatible = "mediatek,camera_main_two";
				reg = <0x10>;
				status = "okay";
				phandle = <0x5d>;
			};

			camera_main_two_eeprom@51 {
				compatible = "mediatek,camera_main_two_eeprom";
				reg = <0x51>;
				status = "okay";
				phandle = <0x5e>;
			};

			ccu_sensor_i2c_2_hw@11 {
				compatible = "mediatek,ccu_sensor_i2c_2_hw";
				reg = <0x11>;
				status = "okay";
				phandle = <0x5f>;
			};

			camera_main_two_af@1c {
				compatible = "mediatek,camera_main_two_af";
				reg = <0x1c>;
				status = "okay";
				phandle = <0x60>;
			};
		};
	};

	fragment@31 {
		target = <0xffffffff>;

		__overlay__ {
			#address-cells = <0x01>;
			#size-cells = <0x00>;
			clock-frequency = <0x61a80>;
			mediatek,use-open-drain;

			nfc@08 {
				compatible = "mediatek,nfc";
				reg = <0x08>;
				status = "okay";
				phandle = <0x61>;
			};
		};
	};

	fragment@32 {
		target = <0xffffffff>;

		__overlay__ {
			#address-cells = <0x01>;
			#size-cells = <0x00>;
			clock-frequency = <0x61a80>;
			mediatek,use-open-drain;

			camera_sub@2d {
				compatible = "mediatek,camera_sub";
				reg = <0x2d>;
				status = "okay";
				phandle = <0x62>;
			};

			camera_sub_eeprom@52 {
				compatible = "mediatek,camera_sub_eeprom";
				reg = <0x52>;
				status = "okay";
				phandle = <0x63>;
			};

			ccu_sensor_i2c_4_hw@12 {
				compatible = "mediatek,ccu_sensor_i2c_4_hw";
				reg = <0x12>;
				status = "okay";
				phandle = <0x64>;
			};
		};
	};

	fragment@33 {
		target = <0xffffffff>;

		__overlay__ {
			#address-cells = <0x01>;
			#size-cells = <0x00>;
			clock-frequency = <0x61a80>;
			mediatek,use-open-drain;
		};
	};

	fragment@34 {
		target = <0xffffffff>;

		__overlay__ {
			#address-cells = <0x01>;
			#size-cells = <0x00>;
			clock-frequency = <0x61a80>;
			mediatek,use-open-drain;

			usb_type_c@4e {
				compatible = "mediatek,usb_type_c";
				reg = <0x4e>;
				status = "okay";
				phandle = <0x65>;
			};
		};
	};

	fragment@35 {
		target = <0xffffffff>;

		__overlay__ {
			#address-cells = <0x01>;
			#size-cells = <0x00>;
			clock-frequency = <0x61a80>;
			mediatek,use-open-drain;

			speaker_amp@34 {
				compatible = "mediatek,speaker_amp";
				reg = <0x34>;
				status = "okay";
				phandle = <0x66>;
			};

			slave_charger@4b {
				compatible = "mediatek,slave_charger";
				reg = <0x4b>;
				status = "okay";
				phandle = <0x67>;
			};
		};
	};

	fragment@36 {
		target = <0xffffffff>;

		__overlay__ {
			#address-cells = <0x01>;
			#size-cells = <0x00>;
			clock-frequency = <0x61a80>;
			mediatek,use-open-drain;
		};
	};

	fragment@37 {
		target = <0xffffffff>;

		__overlay__ {
			GPIO_SIM2_HOT_PLUG = <0xffffffff 0x2e 0x00>;
			GPIO_SIM1_HOT_PLUG = <0xffffffff 0x2f 0x00>;
			GPIO_SIM2_SIO = <0xffffffff 0x9b 0x00>;
			GPIO_SIM2_SRST = <0xffffffff 0x9c 0x00>;
			GPIO_SIM2_SCLK = <0xffffffff 0x9d 0x00>;
			GPIO_SIM1_SCLK = <0xffffffff 0xac 0x00>;
			GPIO_SIM1_SRST = <0xffffffff 0xad 0x00>;
			GPIO_SIM1_SIO = <0xffffffff 0xae 0x00>;
		};
	};

	fragment@38 {
		target = <0xffffffff>;

		__overlay__ {
			gpio_init_default = <0x00 0x00 0x01 0x00 0x01 0x00 0x01 0x01 0x00 0x00 0x00 0x01 0x01 0x01 0x02 0x00 0x00 0x00 0x00 0x00 0x01 0x03 0x00 0x00 0x00 0x01 0x00 0x01 0x04 0x00 0x00 0x00 0x00 0x00 0x00 0x05 0x00 0x00 0x00 0x01 0x00 0x00 0x06 0x00 0x00 0x00 0x01 0x01 0x00 0x07 0x00 0x00 0x00 0x01 0x00 0x00 0x08 0x00 0x01 0x00 0x00 0x00 0x00 0x09 0x00 0x00 0x00 0x01 0x00 0x00 0x0a 0x00 0x00 0x00 0x01 0x01 0x00 0x0b 0x01 0x00 0x00 0x01 0x00 0x00 0x0c 0x00 0x00 0x00 0x01 0x00 0x00 0x0d 0x00 0x01 0x00 0x01 0x01 0x00 0x0e 0x00 0x01 0x00 0x01 0x01 0x00 0x0f 0x00 0x01 0x00 0x01 0x01 0x00 0x10 0x00 0x01 0x00 0x01 0x01 0x00 0x11 0x00 0x01 0x00 0x01 0x01 0x01 0x12 0x00 0x00 0x00 0x01 0x01 0x01 0x13 0x00 0x00 0x00 0x01 0x01 0x01 0x14 0x00 0x00 0x00 0x01 0x01 0x01 0x15 0x00 0x01 0x00 0x01 0x01 0x00 0x16 0x00 0x00 0x00 0x01 0x01 0x00 0x17 0x00 0x01 0x00 0x00 0x00 0x00 0x18 0x00 0x01 0x00 0x00 0x00 0x00 0x19 0x02 0x01 0x00 0x01 0x00 0x00 0x1a 0x02 0x01 0x00 0x00 0x00 0x00 0x1b 0x02 0x01 0x00 0x01 0x00 0x00 0x1c 0x02 0x00 0x00 0x01 0x00 0x00 0x1d 0x00 0x01 0x00 0x00 0x00 0x00 0x1e 0x00 0x01 0x00 0x00 0x00 0x00 0x1f 0x00 0x01 0x00 0x00 0x00 0x00 0x20 0x01 0x00 0x00 0x01 0x00 0x00 0x21 0x01 0x00 0x00 0x01 0x00 0x00 0x22 0x01 0x01 0x00 0x01 0x00 0x00 0x23 0x01 0x01 0x00 0x00 0x00 0x00 0x24 0x01 0x01 0x00 0x00 0x00 0x00 0x25 0x01 0x01 0x00 0x00 0x00 0x00 0x26 0x01 0x01 0x00 0x00 0x00 0x00 0x27 0x00 0x00 0x00 0x01 0x01 0x01 0x28 0x01 0x00 0x00 0x01 0x00 0x00 0x29 0x00 0x00 0x00 0x00 0x00 0x01 0x2a 0x00 0x00 0x00 0x01 0x00 0x01 0x2b 0x01 0x01 0x00 0x00 0x00 0x00 0x2c 0x01 0x00 0x00 0x01 0x00 0x00 0x2d 0x00 0x01 0x00 0x00 0x00 0x00 0x2e 0x01 0x00 0x00 0x01 0x01 0x00 0x2f 0x01 0x00 0x00 0x01 0x01 0x00 0x30 0x01 0x00 0x00 0x01 0x01 0x01 0x31 0x01 0x00 0x00 0x01 0x01 0x01 0x32 0x01 0x00 0x00 0x01 0x01 0x01 0x33 0x01 0x00 0x00 0x01 0x01 0x01 0x34 0x00 0x01 0x00 0x01 0x00 0x00 0x35 0x01 0x00 0x00 0x01 0x00 0x00 0x36 0x01 0x00 0x00 0x01 0x00 0x00 0x37 0x01 0x00 0x00 0x01 0x00 0x00 0x38 0x01 0x00 0x00 0x01 0x00 0x00 0x39 0x01 0x00 0x00 0x01 0x00 0x00 0x3a 0x00 0x00 0x00 0x01 0x00 0x00 0x3b 0x01 0x00 0x00 0x01 0x00 0x00 0x3c 0x01 0x00 0x00 0x01 0x00 0x00 0x3d 0x01 0x00 0x00 0x01 0x00 0x00 0x3e 0x01 0x00 0x00 0x01 0x00 0x00 0x3f 0x01 0x00 0x00 0x01 0x00 0x00 0x40 0x01 0x00 0x00 0x01 0x00 0x00 0x41 0x01 0x00 0x00 0x01 0x00 0x00 0x42 0x01 0x00 0x00 0x01 0x00 0x00 0x43 0x01 0x00 0x00 0x01 0x00 0x00 0x44 0x01 0x00 0x00 0x01 0x00 0x00 0x45 0x01 0x00 0x00 0x01 0x00 0x00 0x46 0x01 0x00 0x00 0x01 0x00 0x00 0x47 0x01 0x00 0x00 0x01 0x00 0x00 0x48 0x01 0x00 0x00 0x01 0x00 0x00 0x49 0x01 0x00 0x00 0x01 0x00 0x00 0x4a 0x01 0x00 0x00 0x01 0x00 0x00 0x4b 0x01 0x00 0x00 0x01 0x00 0x00 0x4c 0x01 0x00 0x00 0x01 0x00 0x00 0x4d 0x01 0x00 0x00 0x01 0x00 0x00 0x4e 0x01 0x00 0x00 0x01 0x00 0x00 0x4f 0x00 0x01 0x00 0x00 0x00 0x00 0x50 0x00 0x01 0x00 0x00 0x00 0x00 0x51 0x02 0x00 0x00 0x01 0x01 0x01 0x52 0x01 0x00 0x00 0x01 0x01 0x01 0x53 0x01 0x00 0x00 0x01 0x01 0x01 0x54 0x02 0x00 0x00 0x01 0x01 0x01 0x55 0x02 0x00 0x00 0x01 0x00 0x00 0x56 0x02 0x01 0x00 0x00 0x00 0x00 0x57 0x02 0x01 0x00 0x00 0x00 0x00 0x58 0x02 0x01 0x00 0x00 0x00 0x00 0x59 0x01 0x00 0x00 0x01 0x01 0x01 0x5a 0x01 0x00 0x00 0x01 0x01 0x01 0x5b 0x00 0x01 0x00 0x00 0x00 0x00 0x5c 0x00 0x01 0x00 0x00 0x00 0x00 0x5d 0x01 0x00 0x00 0x01 0x01 0x00 0x5e 0x01 0x00 0x00 0x01 0x01 0x00 0x5f 0x01 0x00 0x00 0x01 0x01 0x00 0x60 0x01 0x01 0x00 0x00 0x00 0x00 0x61 0x00 0x01 0x00 0x00 0x00 0x00 0x62 0x00 0x01 0x00 0x00 0x00 0x00 0x63 0x01 0x01 0x00 0x00 0x00 0x00 0x64 0x01 0x01 0x00 0x00 0x00 0x00 0x65 0x00 0x01 0x00 0x00 0x00 0x00 0x66 0x00 0x01 0x00 0x00 0x00 0x00 0x67 0x01 0x00 0x00 0x01 0x01 0x01 0x68 0x01 0x00 0x00 0x01 0x01 0x01 0x69 0x01 0x00 0x00 0x01 0x01 0x01 0x6a 0x01 0x00 0x00 0x01 0x01 0x01 0x6b 0x00 0x01 0x00 0x00 0x00 0x00 0x6c 0x01 0x01 0x00 0x00 0x00 0x00 0x6d 0x00 0x01 0x00 0x00 0x00 0x00 0x6e 0x00 0x01 0x00 0x00 0x00 0x00 0x6f 0x01 0x01 0x00 0x00 0x00 0x00 0x70 0x00 0x00 0x00 0x00 0x00 0x00 0x71 0x00 0x00 0x00 0x01 0x00 0x00 0x72 0x00 0x00 0x00 0x01 0x00 0x00 0x73 0x00 0x00 0x00 0x01 0x00 0x00 0x74 0x00 0x00 0x00 0x01 0x00 0x00 0x75 0x00 0x00 0x00 0x01 0x00 0x00 0x76 0x00 0x00 0x00 0x01 0x00 0x00 0x77 0x00 0x00 0x00 0x01 0x00 0x00 0x78 0x00 0x00 0x00 0x01 0x00 0x00 0x79 0x00 0x00 0x00 0x01 0x00 0x00 0x86 0x01 0x00 0x00 0x01 0x00 0x01 0x87 0x01 0x01 0x00 0x00 0x00 0x00 0x88 0x01 0x01 0x00 0x00 0x00 0x00 0x89 0x01 0x01 0x00 0x00 0x00 0x00 0x8a 0x01 0x01 0x00 0x00 0x00 0x00 0x8b 0x01 0x01 0x00 0x00 0x00 0x00 0x8c 0x01 0x00 0x00 0x01 0x00 0x00 0x8d 0x01 0x00 0x00 0x01 0x00 0x00 0x8e 0x01 0x00 0x00 0x01 0x00 0x00 0x8f 0x01 0x00 0x00 0x01 0x00 0x00 0x90 0x01 0x00 0x00 0x01 0x00 0x00 0x91 0x01 0x01 0x00 0x00 0x00 0x00 0x92 0x01 0x01 0x00 0x00 0x00 0x00 0x93 0x01 0x01 0x00 0x00 0x00 0x00 0x94 0x01 0x01 0x00 0x00 0x00 0x00 0x95 0x01 0x01 0x00 0x00 0x00 0x00 0x96 0x00 0x01 0x00 0x00 0x00 0x00 0x97 0x00 0x01 0x00 0x00 0x00 0x00 0x98 0x00 0x01 0x00 0x00 0x00 0x00 0x99 0x00 0x01 0x00 0x00 0x00 0x00 0x9a 0x01 0x01 0x00 0x00 0x00 0x00 0x9b 0x01 0x00 0x00 0x01 0x01 0x00 0x9c 0x01 0x01 0x00 0x00 0x00 0x00 0x9d 0x01 0x01 0x00 0x00 0x00 0x00 0x9e 0x00 0x01 0x00 0x00 0x00 0x00 0x9f 0x00 0x01 0x00 0x00 0x00 0x00 0xa0 0x00 0x01 0x00 0x00 0x00 0x00 0xa1 0x01 0x00 0x00 0x01 0x01 0x01 0xa2 0x01 0x00 0x00 0x01 0x01 0x01 0xa3 0x01 0x00 0x00 0x01 0x01 0x01 0xa4 0x01 0x00 0x00 0x01 0x01 0x01 0xa5 0x00 0x01 0x00 0x00 0x00 0x00 0xa6 0x00 0x01 0x00 0x00 0x00 0x00 0xa7 0x01 0x00 0x00 0x01 0x00 0x00 0xa8 0x01 0x00 0x00 0x01 0x00 0x00 0xa9 0x00 0x01 0x00 0x00 0x00 0x00 0xaa 0x01 0x00 0x00 0x01 0x01 0x01 0xab 0x01 0x01 0x00 0x00 0x00 0x01 0xac 0x01 0x01 0x00 0x00 0x00 0x00 0xad 0x01 0x01 0x00 0x00 0x00 0x00 0xae 0x01 0x00 0x00 0x01 0x01 0x00 0xaf 0x01 0x00 0x00 0x01 0x01 0x01 0xb0 0x01 0x00 0x00 0x01 0x01 0x01 0xb2 0x00 0x01 0x00 0x00 0x00 0x00 0xb3 0x00 0x01 0x00 0x00 0x00 0x00 0xb4 0x00 0x00 0x00 0x01 0x00 0x00 0xb5 0x00 0x00 0x00 0x01 0x00 0x00 0xb6 0x00 0x00 0x00 0x01 0x00 0x00 0xb7 0x00 0x00 0x00 0x01 0x00 0x00 0xb8 0x00 0x00 0x00 0x01 0x00 0x00 0xb9 0x00 0x00 0x00 0x01 0x00 0x00 0xba 0x00 0x00 0x00 0x01 0x00 0x00>;
		};
	};

	fragment@39 {
		target = <0xffffffff>;

		__overlay__ {
			interrupt-parent = <0xffffffff>;
			interrupts = <0x01 0x02 0x01 0x00>;
			status = "okay";
		};
	};

	fragment@40 {
		target = <0xffffffff>;

		__overlay__ {
			interrupt-parent = <0xffffffff>;
			interrupts = <0x14 0x02 0x14 0x00>;
			status = "okay";
		};
	};

	fragment@41 {
		target = <0xffffffff>;

		__overlay__ {
			interrupt-parent = <0xffffffff>;
			interrupts = <0x27 0x08 0x27 0x00>;
			status = "okay";
		};
	};

	fragment@42 {
		target = <0xffffffff>;

		__overlay__ {
			interrupt-parent = <0xffffffff>;
			interrupts = <0x29 0x02 0x29 0x00>;
			status = "okay";
		};
	};

	fragment@43 {
		target = <0xffffffff>;

		__overlay__ {
			interrupt-parent = <0xffffffff>;
			interrupts = <0x2a 0x02 0x2a 0x00>;
			status = "okay";
		};
	};

	fragment@44 {
		target = <0xffffffff>;

		__overlay__ {
			interrupt-parent = <0xffffffff>;
			interrupts = <0x2c 0x01 0x2c 0x01>;
			status = "okay";
		};
	};

	fragment@45 {
		target = <0xffffffff>;

		__overlay__ {
			interrupt-parent = <0xffffffff>;
			interrupts = <0x90 0x04 0xb4 0x00>;
			status = "okay";
		};
	};

	fragment@46 {
		target = <0xffffffff>;

		__overlay__ {
			compatible = "mediatek,md1_sim1_hot_plug_eint-eint";
			interrupts = <0x00 0x04>;
			debounce = <0x00 0x2710>;
			dedicated = <0x00 0x00>;
			src_pin = <0x00 0x01>;
			sockettype = <0x00 0x00>;
			status = "okay";
		};
	};

	fragment@47 {
		target = <0xffffffff>;

		__overlay__ {
			compatible = "mediatek,md1_sim2_hot_plug_eint-eint";
			interrupts = <0x01 0x04>;
			debounce = <0x01 0x2710>;
			dedicated = <0x01 0x00>;
			src_pin = <0x01 0x02>;
			sockettype = <0x01 0x00>;
			status = "okay";
		};
	};

	fragment@48 {
		target = <0xffffffff>;

		__overlay__ {
			regulator-name = "vcama1";
			regulator-default-on = <0x01>;
			status = "okay";
		};
	};

	fragment@49 {
		target = <0xffffffff>;

		__overlay__ {
			regulator-name = "vcama2";
			regulator-default-on = <0x01>;
			status = "okay";
		};
	};

	fragment@50 {
		target = <0xffffffff>;

		__overlay__ {
			regulator-name = "vsim1";
			regulator-default-on = <0x01>;
			status = "okay";
		};
	};

	fragment@51 {
		target = <0xffffffff>;

		__overlay__ {
			regulator-name = "vsim2";
			regulator-default-on = <0x01>;
			status = "okay";
		};
	};

	fragment@52 {
		target = <0xffffffff>;

		__overlay__ {
			regulator-name = "vcamd";
			regulator-default-on = <0x01>;
			status = "okay";
		};
	};

	fragment@53 {
		target = <0xffffffff>;

		__overlay__ {
			regulator-name = "vcamio";
			regulator-default-on = <0x01>;
			status = "okay";
		};
	};

	fragment@54 {
		target = <0xffffffff>;

		__overlay__ {
			regulator-name = "vldo28";
			regulator-default-on = <0x01>;
			status = "okay";
		};
	};

	fragment@55 {
		target = <0xffffffff>;

		__overlay__ {
			vcama-supply = <0xffffffff>;
			vcama_sub-supply = <0xffffffff>;
			vcamd_main2-supply = <0xffffffff>;
			vcamio-supply = <0xffffffff>;
			vcamio_sub-supply = <0xffffffff>;
			vcamio_main2-supply = <0xffffffff>;
			vcamaf-supply = <0xffffffff>;
			vcamaf_sub-supply = <0xffffffff>;
			vcamaf_main2-supply = <0xffffffff>;
			status = "okay";
		};
	};

	fragment@56 {
		target = <0xffffffff>;

		__overlay__ {
			vtouch-supply = <0xffffffff>;
			status = "okay";
		};
	};

	fragment@57 {
		target = <0xffffffff>;

		__overlay__ {
			mediatek,kpd-key-debounce = <0x400>;
			mediatek,kpd-sw-pwrkey = <0x74>;
			mediatek,kpd-hw-pwrkey = <0x08>;
			mediatek,kpd-sw-rstkey = <0x73>;
			mediatek,kpd-hw-rstkey = <0x11>;
			mediatek,kpd-use-extend-type = <0x00>;
			mediatek,kpd-hw-map-num = <0x48>;
			mediatek,kpd-hw-init-map = <0x72 0x00 0x00 0x00 0x00 0x00 0x00 0x00 0x00 0x00 0x00 0x00 0x00 0x00 0x00 0x00 0x00 0x00 0x00 0x00 0x00 0x00 0x00 0x00 0x00 0x00 0x00 0x00 0x00 0x00 0x00 0x00 0x00 0x00 0x00 0x00 0x00 0x00 0x00 0x00 0x00 0x00 0x00 0x00 0x00 0x00 0x00 0x00 0x00 0x00 0x00 0x00 0x00 0x00 0x00 0x00 0x00 0x00 0x00 0x00 0x00 0x00 0x00 0x00 0x00 0x00 0x00 0x00 0x00 0x00 0x00 0x00>;
			mediatek,kpd-pwrkey-eint-gpio = <0x00>;
			mediatek,kpd-pwkey-gpio-din = <0x00>;
			mediatek,kpd-hw-dl-key0 = <0x11>;
			mediatek,kpd-hw-dl-key1 = <0x00>;
			mediatek,kpd-hw-dl-key2 = <0x08>;
			mediatek,kpd-hw-recovery-key = <0x11>;
			mediatek,kpd-hw-factory-key = <0x00>;
			status = "okay";
		};
	};

	fragment@58 {
		target = <0xffffffff>;

		__overlay__ {

			camera0_mclk_2mA@gpio99 {
				phandle = <0x3a>;

				pins_cmd_dat {
					pinmux = <0x6301>;
					drive-strength = <0x02>;
				};
			};

			camera0_mclk_4mA@gpio99 {
				phandle = <0x3b>;

				pins_cmd_dat {
					pinmux = <0x6301>;
					drive-strength = <0x04>;
				};
			};

			camera0_mclk_6mA@gpio99 {
				phandle = <0x3c>;

				pins_cmd_dat {
					pinmux = <0x6301>;
					drive-strength = <0x06>;
				};
			};

			camera0_mclk_8mA@gpio99 {
				phandle = <0x3d>;

				pins_cmd_dat {
					pinmux = <0x6301>;
					drive-strength = <0x07>;
				};
			};

			camera0_mclk_gpio_mode@gpio99 {
				phandle = <0x39>;

				pins_cmd_dat {
					pinmux = <0x6300>;
					drive-strength = <0x04>;
				};
			};

			camera1_mclk_2mA@gpio100 {
				phandle = <0x3f>;

				pins_cmd_dat {
					pinmux = <0x6401>;
					drive-strength = <0x02>;
				};
			};

			camera1_mclk_4mA@gpio100 {
				phandle = <0x40>;

				pins_cmd_dat {
					pinmux = <0x6401>;
					drive-strength = <0x04>;
				};
			};

			camera1_mclk_6mA@gpio100 {
				phandle = <0x41>;

				pins_cmd_dat {
					pinmux = <0x6401>;
					drive-strength = <0x06>;
				};
			};

			camera1_mclk_8mA@gpio100 {
				phandle = <0x42>;

				pins_cmd_dat {
					pinmux = <0x6401>;
					drive-strength = <0x07>;
				};
			};

			camera1_mclk_gpio_mode@gpio100 {
				phandle = <0x3e>;

				pins_cmd_dat {
					pinmux = <0x6400>;
					drive-strength = <0x04>;
				};
			};

			camera2_mclk_2mA@gpio99 {
				phandle = <0x44>;

				pins_cmd_dat {
					pinmux = <0x6301>;
					drive-strength = <0x02>;
				};
			};

			camera2_mclk_4mA@gpio99 {
				phandle = <0x45>;

				pins_cmd_dat {
					pinmux = <0x6301>;
					drive-strength = <0x04>;
				};
			};

			camera2_mclk_6mA@gpio99 {
				phandle = <0x46>;

				pins_cmd_dat {
					pinmux = <0x6301>;
					drive-strength = <0x06>;
				};
			};

			camera2_mclk_8mA@gpio99 {
				phandle = <0x47>;

				pins_cmd_dat {
					pinmux = <0x6301>;
					drive-strength = <0x07>;
				};
			};

			camera2_mclk_gpio_mode@gpio99 {
				phandle = <0x43>;

				pins_cmd_dat {
					pinmux = <0x6300>;
					drive-strength = <0x04>;
				};
			};

			camera0_rst_output_low@gpio109 {
				phandle = <0x27>;

				pins_cmd_dat {
					pinmux = <0x6d00>;
					output-low;
				};
			};

			camera0_rst_output_high@gpio109 {
				phandle = <0x28>;

				pins_cmd_dat {
					pinmux = <0x6d00>;
					output-high;
				};
			};

			camera0_pdn_output_low@gpio107 {
				phandle = <0x29>;

				pins_cmd_dat {
					pinmux = <0x6b00>;
					output-low;
				};
			};

			camera0_pdn_output_high@gpio107 {
				phandle = <0x2a>;

				pins_cmd_dat {
					pinmux = <0x6b00>;
					output-high;
				};
			};

			camera1_rst_output_low@gpio102 {
				phandle = <0x2b>;

				pins_cmd_dat {
					pinmux = <0x6600>;
					output-low;
				};
			};

			camera1_rst_output_high@gpio102 {
				phandle = <0x2c>;

				pins_cmd_dat {
					pinmux = <0x6600>;
					output-high;
				};
			};

			camera1_pdn_output_low@gpio98 {
				phandle = <0x2d>;

				pins_cmd_dat {
					pinmux = <0x6200>;
					slew-rate = <0x01>;
					output-low;
				};
			};

			camera1_pdn_output_high@gpio98 {
				phandle = <0x2e>;

				pins_cmd_dat {
					pinmux = <0x6200>;
					output-high;
				};
			};

			camera2_rst_output_low@gpio16 {
				phandle = <0x2f>;

				pins_cmd_dat {
					pinmux = <0x1000>;
					output-low;
				};
			};

			camera2_rst_output_high@gpio16 {
				phandle = <0x30>;

				pins_cmd_dat {
					pinmux = <0x1000>;
					output-high;
				};
			};

			camera2_pdn_output_low@gpio14 {
				phandle = <0x31>;

				pins_cmd_dat {
					pinmux = <0xe00>;
					output-low;
				};
			};

			camera2_pdn_output_high@gpio14 {
				phandle = <0x32>;

				pins_cmd_dat {
					pinmux = <0xe00>;
					output-high;
				};
			};

			camera0_vcama_output_low@gpio178 {
				phandle = <0x34>;

				pins_cmd_dat {
					pinmux = <0x4f00>;
					output-low;
				};
			};

			camera0_vcama_output_high@gpio79 {
				phandle = <0x33>;

				pins_cmd_dat {
					pinmux = <0x4f00>;
					output-high;
				};
			};

			camera0_vcamd_output_low@gpio80 {
				phandle = <0x36>;

				pins_cmd_dat {
					pinmux = <0x5000>;
					output-low;
				};
			};

			camera0_vcamd_output_high@gpio80 {
				phandle = <0x35>;

				pins_cmd_dat {
					pinmux = <0x5000>;
					output-high;
				};
			};

			camera1_vcamd_output_low@gpio31 {
				phandle = <0x38>;

				pins_cmd_dat {
					pinmux = <0x1f00>;
					output-low;
				};
			};

			camera1_vcamd_output_high@gpio31 {
				phandle = <0x37>;

				pins_cmd_dat {
					pinmux = <0x1f00>;
					output-high;
				};
			};

			camera2_vcama_output_low@gpio107 {
				phandle = <0x68>;

				pins_cmd_dat {
					pinmux = <0x9600>;
					output-low;
				};
			};

			camdefault {
				phandle = <0x26>;
			};
		};
	};

	fragment@59 {
		target = <0xffffffff>;

		__overlay__ {
			pinctrl-names = "default\0cam0_rst0\0cam0_rst1\0cam0_pnd0\0cam0_pnd1\0cam1_rst0\0cam1_rst1\0cam1_pnd0\0cam1_pnd1\0cam2_rst0\0cam2_rst1\0cam2_pnd0\0cam2_pnd1\0cam0_vcama_on\0cam0_vcama_off\0cam0_vcamd_on\0cam0_vcamd_off\0cam1_vcamd_on\0cam1_vcamd_off\0cam0_mclk_off\0cam0_mclk_2mA\0cam0_mclk_4mA\0cam0_mclk_6mA\0cam0_mclk_8mA\0cam1_mclk_off\0cam1_mclk_2mA\0cam1_mclk_4mA\0cam1_mclk_6mA\0cam1_mclk_8mA\0cam2_mclk_off\0cam2_mclk_2mA\0cam2_mclk_4mA\0cam2_mclk_6mA\0cam2_mclk_8mA";
			pinctrl-0 = <0x26>;
			pinctrl-1 = <0x27>;
			pinctrl-2 = <0x28>;
			pinctrl-3 = <0x29>;
			pinctrl-4 = <0x2a>;
			pinctrl-5 = <0x2b>;
			pinctrl-6 = <0x2c>;
			pinctrl-7 = <0x2d>;
			pinctrl-8 = <0x2e>;
			pinctrl-9 = <0x2f>;
			pinctrl-10 = <0x30>;
			pinctrl-11 = <0x31>;
			pinctrl-12 = <0x32>;
			pinctrl-13 = <0x33>;
			pinctrl-14 = <0x34>;
			pinctrl-15 = <0x35>;
			pinctrl-16 = <0x36>;
			pinctrl-17 = <0x37>;
			pinctrl-18 = <0x38>;
			pinctrl-19 = <0x39>;
			pinctrl-20 = <0x3a>;
			pinctrl-21 = <0x3b>;
			pinctrl-22 = <0x3c>;
			pinctrl-23 = <0x3d>;
			pinctrl-24 = <0x3e>;
			pinctrl-25 = <0x3f>;
			pinctrl-26 = <0x40>;
			pinctrl-27 = <0x41>;
			pinctrl-28 = <0x42>;
			pinctrl-29 = <0x43>;
			pinctrl-30 = <0x44>;
			pinctrl-31 = <0x45>;
			pinctrl-32 = <0x46>;
			pinctrl-33 = <0x47>;
			cam1_vcama-supply = <0xffffffff>;
			cam2_vcama-supply = <0xffffffff>;
			cam2_vcamd-supply = <0xffffffff>;
			cam0_vcamio-supply = <0xffffffff>;
			cam1_vcamio-supply = <0xffffffff>;
			cam2_vcamio-supply = <0xffffffff>;
			cam0_vcamaf-supply = <0xffffffff>;
			cam0_enable_sensor = "ov64b40_mipi_raw s5kgm1st_mipi_raw ";
			cam1_enable_sensor = "ov16a1q_mipi_raw gc08a3sub_mipi_raw";
			cam2_enable_sensor = "s5k4h7yx_mipi_raw bf2253Lmacro_mipi_raw";
			status = "okay";
		};
	};

	fragment@60 {
		target = <0xffffffff>;

		__overlay__ {
			camaf_m1_pmic-supply = <0xffffffff>;
			camaf_m2_pmic-supply = <0xffffffff>;
			camaf_m3_pmic-supply = <0xffffffff>;
			status = "okay";
		};
	};

	fragment@61 {
		target = <0xffffffff>;

		__overlay__ {
			clock-frequency = <0x61a80>;

			focaltech@48 {
				compatible = "focaltech,fts";
				reg = <0x48>;
				interrupt-parent = <0xffffffff>;
				interrupts = <0x01 0x02 0x01 0x00>;
				status = "okay";
			};

			tcm_touch@2c {
				compatible = "omnivision,tcm-i2c";
				reg = <0x2c>;
				interrupt-parent = <0xffffffff>;
				interrupts = <0x02 0x01 0x00>;
				pinctrl-names = "pmx_ts_active\0pmx_ts_suspend";
				pinctrl-0 = <0x48 0x49>;
				pinctrl-1 = <0x4a 0x4b>;
				omnivision,irq-gpio = <0xffffffff 0x01 0x2008>;
				omnivision,irq-on-state = <0x00>;
				omnivision,reset-gpio = <0xffffffff 0x17 0x01>;
				omnivision,reset-on-state = <0x00>;
				omnivision,reset-active-ms = <0x14>;
				omnivision,reset-delay-ms = <0xc8>;
				omnivision,power-delay-ms = <0xc8>;
				omnivision,byte-delay-us = <0x00>;
				omnivision,block-delay-us = <0x00>;
				omnivision,ubl-max-freq = <0x2dc6c0>;
				omnivision,ubl-byte-delay-us = <0x14>;
			};
		};
	};

	fragment@62 {
		target = <0xffffffff>;

		__overlay__ {
			tpd-resolution = <0x438 0x924>;
			lcm-resolution = <0x438 0x924>;
			tpd-cfg-version = "config19";
			tpd-max-touch-num = <0x05>;
			interrupt-parent = <0xffffffff>;
			interrupts = <0x01 0x02 0x01 0x00>;
			goodix,eint-gpio = <0xffffffff 0x01 0x00>;
			goodix,reset-gpio = <0xffffffff 0x17 0x00>;
			vtouch-supply = <0xffffffff>;
			gpio_tp_int = <0xffffffff 0x01 0x00>;
			gpio_tp_rst = <0xffffffff 0x17 0x00>;
			tpd-filter-enable = <0x00>;
			tpd-filter-pixel-density = <0xa8>;
			tpd-filter-custom-prameters = <0x00 0x00 0x00 0x00 0x00 0x00 0x00 0x00 0x00 0x00 0x00 0x00>;
			tpd-filter-custom-speed = <0x00 0x00 0x00>;
			status = "okay";
		};
	};

	fragment@63 {
		target = <0xffffffff>;

		__overlay__ {

			eintdefault {
				phandle = <0x69>;
			};

			int_active {
				phandle = <0x48>;

				pins_cmd_dat {
					pinmux = <0x100>;
					input-enable;
					bias-pill-up = <0x67>;
				};
			};

			reset_active {
				phandle = <0x49>;

				pins_cmd_dat {
					pinmux = <0x1700>;
					slew-rate = <0x01>;
					output-high;
				};
			};

			int_suspend {
				phandle = <0x4a>;

				pins_cmd_dat {
					pinmux = <0x100>;
					slew-rate = <0x01>;
					output-low;
				};
			};

			reset_suspend {
				phandle = <0x4b>;

				pins_cmd_dat {
					pinmux = <0x1700>;
					slew-rate = <0x01>;
					output-low;
				};
			};

			i2cmode_default {
				phandle = <0x6a>;

				pins_cmd_dat {
					pinmux = <0x5201 0x5301>;
				};
			};

			int_high {
				phandle = <0x6b>;

				pins_cmd_dat {
					pinmux = <0x100>;
					slew-rate = <0x01>;
					output-high;
				};
			};
		};
	};

	__symbols__ {
		aw881xx_smartpa = "/fragment@2/__overlay__/aw881xx_smartpa@34";
		fingerprint = "/fragment@3/__overlay__/fingerprint@spi2";
		fpc_pins_default = "/fragment@5/__overlay__/fpcdefault";
		fpc_pins_eint_as_int = "/fragment@5/__overlay__/fpceint@0";
		fpc_pins_rst_high = "/fragment@5/__overlay__/fpcrsthigh";
		fpc_pins_rst_low = "/fragment@5/__overlay__/fpcrstlow";
		fpc_pins_pwr_high = "/fragment@5/__overlay__/fpcpwrhigh";
		fpc_pins_pwr_low = "/fragment@5/__overlay__/fpcpwrlow";
		fpc_mode_as_cs = "/fragment@5/__overlay__/fpccs";
		fpc_mode_as_ck = "/fragment@5/__overlay__/fpcck";
		fpc_mode_as_mi = "/fragment@5/__overlay__/fpcmi";
		fpc_mode_as_mo = "/fragment@5/__overlay__/fpcmo";
		fpc_miso_pull_up = "/fragment@5/__overlay__/fpcmisoup";
		fpc_miso_pull_down = "/fragment@5/__overlay__/fpcmisolow";
		fpc_mosi_pull_up = "/fragment@5/__overlay__/fpcmosiup";
		fpc_mosi_pull_down = "/fragment@5/__overlay__/fpcmosilow";
		led0 = "/fragment@6/__overlay__/led@0";
		led1 = "/fragment@6/__overlay__/led@1";
		led2 = "/fragment@6/__overlay__/led@2";
		led3 = "/fragment@6/__overlay__/led@3";
		led4 = "/fragment@6/__overlay__/led@4";
		led5 = "/fragment@6/__overlay__/led@5";
		led6 = "/fragment@6/__overlay__/led@6";
		vibrator0 = "/fragment@6/__overlay__/vibrator@0";
		nfc = "/fragment@9/__overlay__/nfc";
		irq_nfc = "/fragment@9/__overlay__/irq_nfc";
		nfc_st = "/fragment@10/__overlay__/nfc@08";
		kpd_pins_default = "/fragment@13/__overlay__/kpdgpiodefault";
		consys_pins_default = "/fragment@14/__overlay__/consys_default";
		gpslna_pins_init = "/fragment@14/__overlay__/gpslna@0";
		gpslna_pins_oh = "/fragment@14/__overlay__/gpslna@1";
		gpslna_pins_ol = "/fragment@14/__overlay__/gpslna@2";
		fmlna_pins_init = "/fragment@14/__overlay__/fmlna@0";
		fmlna_pins_oh = "/fragment@14/__overlay__/fmlna@1";
		fmlna_pins_ol = "/fragment@14/__overlay__/fmlna@2";
		irtx_gpio_led_default = "/fragment@17/__overlay__/irtx_gpio_led_def@gpio12";
		irtx_gpio_led_set = "/fragment@17/__overlay__/irtx_gpio_led_set@gpio12";
		lcd_bias_pins_enp1 = "/fragment@18/__overlay__/lcdbias_enp_high";
		lcd_bias_pins_enp0 = "/fragment@18/__overlay__/lcdbias_enp_low";
		lcd_bias_pins_enn1 = "/fragment@18/__overlay__/lcdbias_enn_high";
		lcd_bias_pins_enn0 = "/fragment@18/__overlay__/lcdbias_enn_low";
		lcd_bias_pins_default = "/fragment@18/__overlay__/default";
		mtkfb_pins_lcm_rst_out1_gpio = "/fragment@21/__overlay__/lcm_rst_out1_gpio";
		mtkfb_pins_lcm_rst_out0_gpio = "/fragment@21/__overlay__/lcm_rst_out0_gpio";
		mtkfb_pins_lcm_dsi_te = "/fragment@21/__overlay__/lcm_dsi_te";
		aw36518_default = "/fragment@23/__overlay__/aw36518_default";
		aw36518_strobe_0 = "/fragment@23/__overlay__/aw36518_strobe_0";
		aw36518_strobe_1 = "/fragment@23/__overlay__/aw36518_strobe_1";
		aw36518_en_0 = "/fragment@23/__overlay__/aw36518_en_0";
		aw36518_en_1 = "/fragment@23/__overlay__/aw36518_en_1";
		cap_touch_mtk = "/fragment@28/__overlay__/cap_touch@14";
		camera_main_mtk = "/fragment@30/__overlay__/camera_main@1a";
		camera_main_eeprom_mtk = "/fragment@30/__overlay__/camera_main_eeprom@50";
		camera_main_af_mtk = "/fragment@30/__overlay__/camera_main_af@0c";
		camera_main_two_mtk = "/fragment@30/__overlay__/camera_main_two@10";
		camera_main_two_eeprom_mtk = "/fragment@30/__overlay__/camera_main_two_eeprom@51";
		ccu_sensor_i2c_2_hw_mtk = "/fragment@30/__overlay__/ccu_sensor_i2c_2_hw@11";
		camera_main_two_af_mtk = "/fragment@30/__overlay__/camera_main_two_af@1c";
		nfc_mtk = "/fragment@31/__overlay__/nfc@08";
		camera_sub_mtk = "/fragment@32/__overlay__/camera_sub@2d";
		camera_sub_eeprom_mtk = "/fragment@32/__overlay__/camera_sub_eeprom@52";
		ccu_sensor_i2c_4_hw_mtk = "/fragment@32/__overlay__/ccu_sensor_i2c_4_hw@12";
		usb_type_c_mtk = "/fragment@34/__overlay__/usb_type_c@4e";
		speaker_amp_mtk = "/fragment@35/__overlay__/speaker_amp@34";
		slave_charger_mtk = "/fragment@35/__overlay__/slave_charger@4b";
		camera0_mclk_2mA = "/fragment@58/__overlay__/camera0_mclk_2mA@gpio99";
		camera0_mclk_4mA = "/fragment@58/__overlay__/camera0_mclk_4mA@gpio99";
		camera0_mclk_6mA = "/fragment@58/__overlay__/camera0_mclk_6mA@gpio99";
		camera0_mclk_8mA = "/fragment@58/__overlay__/camera0_mclk_8mA@gpio99";
		camera0_mclk_off = "/fragment@58/__overlay__/camera0_mclk_gpio_mode@gpio99";
		camera1_mclk_2mA = "/fragment@58/__overlay__/camera1_mclk_2mA@gpio100";
		camera1_mclk_4mA = "/fragment@58/__overlay__/camera1_mclk_4mA@gpio100";
		camera1_mclk_6mA = "/fragment@58/__overlay__/camera1_mclk_6mA@gpio100";
		camera1_mclk_8mA = "/fragment@58/__overlay__/camera1_mclk_8mA@gpio100";
		camera1_mclk_off = "/fragment@58/__overlay__/camera1_mclk_gpio_mode@gpio100";
		camera2_mclk_2mA = "/fragment@58/__overlay__/camera2_mclk_2mA@gpio99";
		camera2_mclk_4mA = "/fragment@58/__overlay__/camera2_mclk_4mA@gpio99";
		camera2_mclk_6mA = "/fragment@58/__overlay__/camera2_mclk_6mA@gpio99";
		camera2_mclk_8mA = "/fragment@58/__overlay__/camera2_mclk_8mA@gpio99";
		camera2_mclk_off = "/fragment@58/__overlay__/camera2_mclk_gpio_mode@gpio99";
		camera0_rst_low = "/fragment@58/__overlay__/camera0_rst_output_low@gpio109";
		camera0_rst_high = "/fragment@58/__overlay__/camera0_rst_output_high@gpio109";
		camera0_pdn_low = "/fragment@58/__overlay__/camera0_pdn_output_low@gpio107";
		camera0_pdn_high = "/fragment@58/__overlay__/camera0_pdn_output_high@gpio107";
		camera1_rst_low = "/fragment@58/__overlay__/camera1_rst_output_low@gpio102";
		camera1_rst_high = "/fragment@58/__overlay__/camera1_rst_output_high@gpio102";
		camera1_pdn_low = "/fragment@58/__overlay__/camera1_pdn_output_low@gpio98";
		camera1_pdn_high = "/fragment@58/__overlay__/camera1_pdn_output_high@gpio98";
		camera2_rst_low = "/fragment@58/__overlay__/camera2_rst_output_low@gpio16";
		camera2_rst_high = "/fragment@58/__overlay__/camera2_rst_output_high@gpio16";
		camera2_pdn_low = "/fragment@58/__overlay__/camera2_pdn_output_low@gpio14";
		camera2_pdn_high = "/fragment@58/__overlay__/camera2_pdn_output_high@gpio14";
		camera0_vcama_off = "/fragment@58/__overlay__/camera0_vcama_output_low@gpio178";
		camera0_vcama_on = "/fragment@58/__overlay__/camera0_vcama_output_high@gpio79";
		camera0_vcamd_off = "/fragment@58/__overlay__/camera0_vcamd_output_low@gpio80";
		camera0_vcamd_on = "/fragment@58/__overlay__/camera0_vcamd_output_high@gpio80";
		camera1_vcamd_off = "/fragment@58/__overlay__/camera1_vcamd_output_low@gpio31";
		camera1_vcamd_on = "/fragment@58/__overlay__/camera1_vcamd_output_high@gpio31";
		camera2_vcama_off = "/fragment@58/__overlay__/camera2_vcama_output_low@gpio107";
		camera_pins_default = "/fragment@58/__overlay__/camdefault";
		ctp_pins_default = "/fragment@63/__overlay__/eintdefault";
		ctp_ts_int_active = "/fragment@63/__overlay__/int_active";
		ctp_ts_reset_active = "/fragment@63/__overlay__/reset_active";
		ctp_ts_int_suspend = "/fragment@63/__overlay__/int_suspend";
		ctp_ts_reset_suspend = "/fragment@63/__overlay__/reset_suspend";
		ctp_ts_i2c_mode = "/fragment@63/__overlay__/i2cmode_default";
		ctp_ts_int_as_gpio = "/fragment@63/__overlay__/int_high";
	};

	__fixups__ {
		reserved_memory = "/fragment@0:target:0";
		chosen = "/fragment@1:target:0";
		i2c7 = "/fragment@2:target:0\0/fragment@35:target:0";
		pio = "/fragment@2/__overlay__/aw881xx_smartpa@34:reset-gpio:0\0/fragment@2/__overlay__/aw881xx_smartpa@34:irq-gpio:0\0/fragment@4/__overlay__:interrupt-parent:0\0/fragment@5:target:0\0/fragment@7/__overlay__:gpio_lcd_ldo18_gpio:0\0/fragment@7/__overlay__:gpio_lcd_bias_enp_gpio:0\0/fragment@7/__overlay__:gpio_lcd_bias_enn_gpio:0\0/fragment@9/__overlay__/nfc:gpio-rst-std:0\0/fragment@9/__overlay__/nfc:gpio-irq-std:0\0/fragment@9/__overlay__/irq_nfc:interrupt-parent:0\0/fragment@13:target:0\0/fragment@14:target:0\0/fragment@17:target:0\0/fragment@18:target:0\0/fragment@21:target:0\0/fragment@23:target:0\0/fragment@37/__overlay__:GPIO_SIM2_HOT_PLUG:0\0/fragment@37/__overlay__:GPIO_SIM1_HOT_PLUG:0\0/fragment@37/__overlay__:GPIO_SIM2_SIO:0\0/fragment@37/__overlay__:GPIO_SIM2_SRST:0\0/fragment@37/__overlay__:GPIO_SIM2_SCLK:0\0/fragment@37/__overlay__:GPIO_SIM1_SCLK:0\0/fragment@37/__overlay__:GPIO_SIM1_SRST:0\0/fragment@37/__overlay__:GPIO_SIM1_SIO:0\0/fragment@39/__overlay__:interrupt-parent:0\0/fragment@40/__overlay__:interrupt-parent:0\0/fragment@41/__overlay__:interrupt-parent:0\0/fragment@42/__overlay__:interrupt-parent:0\0/fragment@43/__overlay__:interrupt-parent:0\0/fragment@44/__overlay__:interrupt-parent:0\0/fragment@45/__overlay__:interrupt-parent:0\0/fragment@58:target:0\0/fragment@61/__overlay__/focaltech@48:interrupt-parent:0\0/fragment@61/__overlay__/tcm_touch@2c:interrupt-parent:0\0/fragment@61/__overlay__/tcm_touch@2c:omnivision,irq-gpio:0\0/fragment@61/__overlay__/tcm_touch@2c:omnivision,reset-gpio:0\0/fragment@62/__overlay__:interrupt-parent:0\0/fragment@62/__overlay__:goodix,eint-gpio:0\0/fragment@62/__overlay__:goodix,reset-gpio:0\0/fragment@62/__overlay__:gpio_tp_int:0\0/fragment@62/__overlay__:gpio_tp_rst:0\0/fragment@63:target:0";
		spi2 = "/fragment@3:target:0";
		fpc = "/fragment@4:target:0";
		odm = "/fragment@6:target:0\0/fragment@9:target:0";
		lcm_power_gpio = "/fragment@7:target:0";
		i2c2 = "/fragment@8:target:0\0/fragment@30:target:0";
		i2c3 = "/fragment@10:target:0\0/fragment@31:target:0";
		accdet = "/fragment@11:target:0";
		keypad = "/fragment@12:target:0\0/fragment@57:target:0";
		consys = "/fragment@15:target:0";
		irtx_pwm = "/fragment@16:target:0";
		i2c_lcd_bias_mtk = "/fragment@19:target:0";
		i2c0 = "/fragment@20:target:0\0/fragment@24:target:0\0/fragment@28:target:0\0/fragment@61:target:0";
		mtkfb = "/fragment@22:target:0";
		auxadc = "/fragment@25:target:0\0/fragment@26/__overlay__:io-channels:0";
		md_auxadc = "/fragment@26:target:0";
		pmic_clock_buffer_ctrl = "/fragment@27:target:0";
		i2c1 = "/fragment@29:target:0";
		i2c4 = "/fragment@32:target:0";
		i2c5 = "/fragment@33:target:0";
		i2c6 = "/fragment@34:target:0";
		i2c8 = "/fragment@36:target:0";
		gpio_usage_mapping = "/fragment@37:target:0";
		gpio = "/fragment@38:target:0";
		touch = "/fragment@39:target:0\0/fragment@56:target:0\0/fragment@62:target:0";
		subpmic_pmu_eint = "/fragment@40:target:0";
		smart_pa = "/fragment@41:target:0";
		tcpc_pd = "/fragment@42:target:0";
		rt9465_slave_chr = "/fragment@43:target:0";
		dsi_te = "/fragment@44:target:0";
		main_pmic = "/fragment@45:target:0";
		md1_sim1_hot_plug_eint = "/fragment@46:target:0";
		md1_sim2_hot_plug_eint = "/fragment@47:target:0";
		mt_pmic_vcama1_ldo_reg = "/fragment@48:target:0\0/fragment@55/__overlay__:vcama-supply:0\0/fragment@59/__overlay__:cam2_vcama-supply:0";
		mt_pmic_vcama2_ldo_reg = "/fragment@49:target:0\0/fragment@55/__overlay__:vcama_sub-supply:0\0/fragment@59/__overlay__:cam1_vcama-supply:0";
		mt_pmic_vsim1_ldo_reg = "/fragment@50:target:0";
		mt_pmic_vsim2_ldo_reg = "/fragment@51:target:0";
		mt_pmic_vcamd_ldo_reg = "/fragment@52:target:0\0/fragment@55/__overlay__:vcamd_main2-supply:0\0/fragment@59/__overlay__:cam2_vcamd-supply:0";
		mt_pmic_vcamio_ldo_reg = "/fragment@53:target:0\0/fragment@55/__overlay__:vcamio-supply:0\0/fragment@55/__overlay__:vcamio_sub-supply:0\0/fragment@55/__overlay__:vcamio_main2-supply:0\0/fragment@59/__overlay__:cam0_vcamio-supply:0\0/fragment@59/__overlay__:cam1_vcamio-supply:0\0/fragment@59/__overlay__:cam2_vcamio-supply:0";
		mt_pmic_vldo28_ldo_reg = "/fragment@54:target:0\0/fragment@55/__overlay__:vcamaf-supply:0\0/fragment@55/__overlay__:vcamaf_sub-supply:0\0/fragment@55/__overlay__:vcamaf_main2-supply:0\0/fragment@56/__overlay__:vtouch-supply:0\0/fragment@59/__overlay__:cam0_vcamaf-supply:0\0/fragment@60/__overlay__:camaf_m1_pmic-supply:0\0/fragment@60/__overlay__:camaf_m2_pmic-supply:0\0/fragment@60/__overlay__:camaf_m3_pmic-supply:0\0/fragment@62/__overlay__:vtouch-supply:0";
		kd_camera_hw1 = "/fragment@55:target:0\0/fragment@59:target:0";
		camera_af_hw_node = "/fragment@60:target:0";
	};

	__local_fixups__ {

		fragment@4 {

			__overlay__ {
				pinctrl-0 = <0x00>;
				pinctrl-1 = <0x00>;
				pinctrl-2 = <0x00>;
				pinctrl-3 = <0x00>;
				pinctrl-4 = <0x00>;
				pinctrl-5 = <0x00>;
				pinctrl-6 = <0x00>;
				pinctrl-7 = <0x00>;
				pinctrl-8 = <0x00>;
				pinctrl-9 = <0x00>;
				pinctrl-10 = <0x00>;
				pinctrl-11 = <0x00>;
				pinctrl-12 = <0x00>;
				pinctrl-13 = <0x00>;
			};
		};

		fragment@12 {

			__overlay__ {
				pinctrl-0 = <0x00>;
			};
		};

		fragment@15 {

			__overlay__ {
				pinctrl-0 = <0x00>;
				pinctrl-1 = <0x00>;
				pinctrl-2 = <0x00>;
				pinctrl-3 = <0x00>;
				pinctrl-4 = <0x00>;
				pinctrl-5 = <0x00>;
				pinctrl-6 = <0x00>;
			};
		};

		fragment@16 {

			__overlay__ {
				pinctrl-0 = <0x00>;
				pinctrl-1 = <0x00>;
			};
		};

		fragment@19 {

			__overlay__ {
				pinctrl-0 = <0x00>;
				pinctrl-1 = <0x00>;
				pinctrl-2 = <0x00>;
				pinctrl-3 = <0x00>;
				pinctrl-4 = <0x00>;
			};
		};

		fragment@22 {

			__overlay__ {
				pinctrl-0 = <0x00>;
				pinctrl-1 = <0x00>;
				pinctrl-2 = <0x00>;
			};
		};

		fragment@24 {

			__overlay__ {

				aw36518@63 {
					pinctrl-0 = <0x00>;
					pinctrl-1 = <0x00>;
					pinctrl-2 = <0x00>;
					pinctrl-3 = <0x00>;
					pinctrl-4 = <0x00>;
				};
			};
		};

		fragment@59 {

			__overlay__ {
				pinctrl-0 = <0x00>;
				pinctrl-1 = <0x00>;
				pinctrl-2 = <0x00>;
				pinctrl-3 = <0x00>;
				pinctrl-4 = <0x00>;
				pinctrl-5 = <0x00>;
				pinctrl-6 = <0x00>;
				pinctrl-7 = <0x00>;
				pinctrl-8 = <0x00>;
				pinctrl-9 = <0x00>;
				pinctrl-10 = <0x00>;
				pinctrl-11 = <0x00>;
				pinctrl-12 = <0x00>;
				pinctrl-13 = <0x00>;
				pinctrl-14 = <0x00>;
				pinctrl-15 = <0x00>;
				pinctrl-16 = <0x00>;
				pinctrl-17 = <0x00>;
				pinctrl-18 = <0x00>;
				pinctrl-19 = <0x00>;
				pinctrl-20 = <0x00>;
				pinctrl-21 = <0x00>;
				pinctrl-22 = <0x00>;
				pinctrl-23 = <0x00>;
				pinctrl-24 = <0x00>;
				pinctrl-25 = <0x00>;
				pinctrl-26 = <0x00>;
				pinctrl-27 = <0x00>;
				pinctrl-28 = <0x00>;
				pinctrl-29 = <0x00>;
				pinctrl-30 = <0x00>;
				pinctrl-31 = <0x00>;
				pinctrl-32 = <0x00>;
				pinctrl-33 = <0x00>;
			};
		};

		fragment@61 {

			__overlay__ {

				tcm_touch@2c {
					pinctrl-0 = <0x00 0x04>;
					pinctrl-1 = <0x00 0x04>;
				};
			};
		};
	};
};
